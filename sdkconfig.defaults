## sdkconfig.defaults.esp32s3
```kconfig
# Bluetooth duplicate handling
CONFIG_BT_CTRL_DUPL_SCAN_CACHE_REFRESH_PERIOD=10
CONFIG_BT_CTRL_SCAN_DUPL_CACHE_SIZE=1000

## WIFI RX Buffers
CONFIG_ESP_WIFI_RX_MGMT_BUF_NUM_DEF=10
CONFIG_ESP_WIFI_DYNAMIC_RX_BUFFER_NUM=64

## Pin Bluetooth tasks to Core 1
CONFIG_BT_CTRL_PINNED_TO_CORE_1=y
CONFIG_BT_NIMBLE_PINNED_TO_CORE_1=y
```
